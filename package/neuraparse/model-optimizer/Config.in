## package/neuraparse/qulacs/Config.in
```kconfig
config BR2_PACKAGE_QULACS
	bool "qulacs"
	depends on BR2_INSTALL_LIBSTDCPP
	select BR2_PACKAGE_BOOST
	help
	  Qulacs is a fast quantum circuit simulator for simulating
	  large, noisy, or parametric quantum circuits.

	  Features:
	  - C++ with static library architecture
	  - SIMD optimizations (AVX2)
	  - OpenMP parallelization
	  - Optional CUDA/ROCm GPU support

	  https://github.com/qulacs/qulacs
```

## package/neuraparse/ros2-micro/Config.in
```kconfig
config BR2_PACKAGE_ROS2_MICRO
	bool "ros2-micro"
	depends on BR2_INSTALL_LIBSTDCPP
	depends on BR2_TOOLCHAIN_HAS_THREADS
	help
	  micro-ROS - ROS 2 for microcontrollers and embedded systems

	  micro-ROS brings the ROS 2 ecosystem to resource-constrained
	  devices, enabling robotics applications on embedded platforms.

	  Key Features:
	  - Full ROS 2 compatibility
	  - Minimal resource footprint
	  - Real-time capable
	  - Multiple RTOS support (FreeRTOS, Zephyr, NuttX)
	  - DDS-XRCE communication
	  - Agent-based architecture
	  - Standard ROS 2 message types
	  - Service and action support

	  Components:
	  - micro-ROS Agent: Bridge to ROS 2 network
	  - micro-ROS Client: Embedded library
	  - rcl/rclc: ROS Client Library for C
	  - rmw_microxrcedds: Middleware implementation

	  Use Cases:
	  - Sensor nodes
	  - Motor controllers
	  - Edge computing
	  - Swarm robotics
	  - Industrial IoT

	  https://micro.ros.org

if BR2_PACKAGE_ROS2_MICRO

config BR2_PACKAGE_ROS2_MICRO_AGENT
	bool "micro-ROS Agent"
	default y
	help
	  Build the micro-ROS Agent that bridges embedded
	  devices to the ROS 2 network.

config BR2_PACKAGE_ROS2_MICRO_DEMOS
	bool "Demo applications"
	help
	  Include micro-ROS demo applications.

endif
```

## package/neuraparse/stable-diffusion-cpp/Config.in
```kconfig
config BR2_PACKAGE_STABLE_DIFFUSION_CPP
	bool "stable-diffusion-cpp"
	depends on BR2_INSTALL_LIBSTDCPP
	depends on BR2_TOOLCHAIN_HAS_THREADS
	help
	  stable-diffusion.cpp - Stable Diffusion inference in C/C++

	  Inference of Stable Diffusion image generation models in
	  pure C/C++ using ggml tensor library (same as llama.cpp).

	  Key Features:
	  - No dependencies, pure C/C++ implementation
	  - Support for SD 1.x, 2.x, SDXL, SD 3.5
	  - GGUF model format for efficient loading
	  - Text-to-image generation
	  - Image-to-image transformation
	  - Inpainting and outpainting
	  - ControlNet support
	  - LoRA adapter support
	  - VAE tiling for high-resolution

	  GPU Acceleration:
	  - CUDA (NVIDIA)
	  - Metal (Apple)
	  - Vulkan (cross-platform)
	  - SYCL (Intel)

	  Memory Requirements:
	  - SD 1.5: ~2GB RAM (quantized)
	  - SDXL: ~4GB RAM (quantized)

	  https://github.com/leejet/stable-diffusion.cpp

if BR2_PACKAGE_STABLE_DIFFUSION_CPP

config BR2_PACKAGE_STABLE_DIFFUSION_CPP_CUDA
	bool "CUDA acceleration"
	help
	  Enable NVIDIA CUDA GPU acceleration.

config BR2_PACKAGE_STABLE_DIFFUSION_CPP_VULKAN
	bool "Vulkan acceleration"
	help
	  Enable Vulkan GPU acceleration.

config BR2_PACKAGE_STABLE_DIFFUSION_CPP_FLASH_ATTN
	bool "Flash Attention"
	help
	  Enable Flash Attention for faster generation.

endif
```

## package/neuraparse/wasmedge/Config.in
```kconfig
config BR2_PACKAGE_WASMEDGE
	bool "wasmedge"
	depends on BR2_INSTALL_LIBSTDCPP
	depends on BR2_TOOLCHAIN_HAS_THREADS
	depends on !BR2_STATIC_LIBS
	help
	  WasmEdge is a lightweight, high-performance WebAssembly
	  runtime optimized for edge computing and AI applications.

	  Features:
	  - WASI-NN support for AI inference
	  - Portable AI models across platforms
	  - AOT compilation for performance
	  - Plugin system for extensibility

	  https://wasmedge.org

if BR2_PACKAGE_WASMEDGE

config BR2_PACKAGE_WASMEDGE_WASI_NN
	bool "WASI-NN plugin"
	default y
	help
	  Enable WASI-NN plugin for running AI models in WebAssembly.

endif

comment "wasmedge needs a toolchain w/ C++, threads, dynamic library"
	depends on !BR2_INSTALL_LIBSTDCPP || !BR2_TOOLCHAIN_HAS_THREADS || BR2_STATIC_LIBS
```

## package/neuraparse/whisper-cpp/Config.in
```kconfig
config BR2_PACKAGE_WHISPER_CPP
	bool "whisper-cpp"
	depends on BR2_INSTALL_LIBSTDCPP
	depends on BR2_TOOLCHAIN_HAS_THREADS
	help
	  whisper.cpp - High-performance speech recognition in C/C++

	  Port of OpenAI's Whisper model in C/C++ for efficient
	  automatic speech recognition on edge devices.

	  Key Features:
	  - No dependencies, pure C/C++ implementation
	  - Supports multiple model sizes (tiny to large-v3)
	  - Real-time transcription capability
	  - Multi-language support (99+ languages)
	  - Voice activity detection (VAD)
	  - Speaker diarization
	  - GPU acceleration (CUDA, Metal, Vulkan)
	  - ARM NEON and x86 AVX optimizations

	  Model Sizes:
	  - tiny: 39M params, ~1GB RAM
	  - base: 74M params, ~1GB RAM
	  - small: 244M params, ~2GB RAM
	  - medium: 769M params, ~5GB RAM
	  - large-v3: 1.5B params, ~10GB RAM

	  https://github.com/ggerganov/whisper.cpp

if BR2_PACKAGE_WHISPER_CPP

config BR2_PACKAGE_WHISPER_CPP_CUDA
	bool "CUDA acceleration"
	help
	  Enable NVIDIA CUDA GPU acceleration.

config BR2_PACKAGE_WHISPER_CPP_VULKAN
	bool "Vulkan acceleration"
	help
	  Enable Vulkan GPU acceleration for cross-platform support.

config BR2_PACKAGE_WHISPER_CPP_COREML
	bool "CoreML acceleration (Apple)"
	depends on BR2_PACKAGE_HAS_COREML
	help
	  Enable Apple CoreML acceleration for Mac/iOS.

endif
```

## package/neuraparse/xacc/Config.in
```kconfig
config BR2_PACKAGE_XACC
	bool "xacc"
	depends on BR2_INSTALL_LIBSTDCPP
	depends on BR2_TOOLCHAIN_HAS_THREADS
	help
	  XACC - eXtreme-scale ACCelerator programming framework

	  XACC is a system-level software infrastructure for
	  heterogeneous quantum-classical computing. It provides
	  a hardware-agnostic programming model.

	  Key Features:
	  - Hardware-agnostic quantum programming
	  - Plugin architecture for multiple backends
	  - Quantum circuit optimization passes
	  - VQE, QAOA, and other hybrid algorithms
	  - Integration with IBM, Rigetti, IonQ, D-Wave
	  - QASM, Quil, and other IR support

	  Components:
	  - XACC Core: IR and compilation framework
	  - TNQVM: Tensor network quantum simulator
	  - QCOR: C++ quantum language extension
	  - ExaTN: Exascale tensor networks

	  https://github.com/eclipse/xacc

if BR2_PACKAGE_XACC

config BR2_PACKAGE_XACC_TNQVM
	bool "TNQVM tensor network simulator"
	default y
	help
	  Enable TNQVM - tensor network quantum virtual machine
	  for efficient simulation of quantum circuits.

config BR2_PACKAGE_XACC_QCOR
	bool "QCOR quantum C++ compiler"
	help
	  Enable QCOR - quantum-classical C++ compiler extension
	  for writing quantum programs in C++.

endif
```

## package/neuraparse/zenoh/Config.in
```kconfig
config BR2_PACKAGE_ZENOH
	bool "zenoh"
	depends on BR2_PACKAGE_HOST_RUSTC
	help
	  Zenoh is a pub/sub/query protocol unifying data in motion,
	  data at rest and computations. It is designed for robotics,
	  IoT, and edge computing.

	  Zenoh is the recommended ROS2 middleware for ROS 2 Kilted
	  and later, replacing DDS in many use cases.

	  Features:
	  - Ultra-low latency pub/sub (<10us)
	  - Works over any network (LAN, WAN, WiFi, 5G)
	  - Minimal footprint for embedded systems
	  - Native ROS2 rmw_zenoh support
	  - Automatic peer discovery

	  https://zenoh.io/

comment "zenoh requires host Rust toolchain"
	depends on !BR2_PACKAGE_HOST_RUSTC
```
