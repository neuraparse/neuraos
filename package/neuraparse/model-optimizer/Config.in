## package/neuraparse/model-optimizer/Config.in
```kconfig
config BR2_PACKAGE_MODEL_OPTIMIZER
	bool "model-optimizer"
	depends on BR2_PACKAGE_PYTHON3
	select BR2_PACKAGE_PYTHON_NUMPY
	select BR2_PACKAGE_ONNX_TOOLS
	help
	  NeuralOS AI Model Optimizer - Tools for optimizing AI models
	  for edge deployment.
	  
	  Features:
	  - Quantization (INT8, FP16)
	  - Pruning and compression
	  - Model conversion (PyTorch → ONNX → TFLite)
	  - Benchmarking and profiling
	  - Automated optimization pipelines
	  
	  https://neuraparse.com

comment "model-optimizer needs Python 3"
	depends on !BR2_PACKAGE_PYTHON3
```

## package/neuraparse/ncnn/Config.in
```kconfig
config BR2_PACKAGE_NCNN
	bool "ncnn"
	depends on BR2_INSTALL_LIBSTDCPP
	depends on BR2_TOOLCHAIN_HAS_THREADS
	depends on BR2_USE_WCHAR
	select BR2_PACKAGE_PROTOBUF
	help
	  ncnn is a high-performance neural network inference framework
	  optimized for mobile platforms. Developed by Tencent.

	  ncnn provides:
	  - High performance on mobile/embedded devices
	  - Optimized for ARM, x86, RISC-V, LoongArch
	  - Vulkan GPU acceleration support
	  - INT8 quantization support
	  - Minimal external dependencies

	  https://github.com/Tencent/ncnn

if BR2_PACKAGE_NCNN

config BR2_PACKAGE_NCNN_VULKAN
	bool "Vulkan support"
	help
	  Enable Vulkan GPU acceleration

config BR2_PACKAGE_NCNN_OPENMP
	bool "OpenMP support"
	default y
	help
	  Enable OpenMP for multi-threading

config BR2_PACKAGE_NCNN_INT8
	bool "INT8 quantization"
	default y
	help
	  Enable INT8 quantization support

endif
```

## package/neuraparse/neuraos-dashboard/Config.in
```kconfig
config BR2_PACKAGE_NEURAOS_DASHBOARD
	bool "neuraos-dashboard"
	depends on BR2_PACKAGE_QT5
	depends on BR2_PACKAGE_QT5BASE
	depends on BR2_PACKAGE_QT5CHARTS
	depends on BR2_PACKAGE_NPIE
	help
	  NeuralOS AI Dashboard - Qt5-based visual interface
	  for AI inference monitoring and model management.
	  
	  Provides real-time visualization of:
	  - AI model inference performance
	  - Hardware accelerator utilization
	  - System resource usage
	  - Model loading and management
```

## package/neuraparse/neuraos-tests/Config.in
```kconfig
config BR2_PACKAGE_NEURAOS_TESTS
	bool "neuraos-tests"
	help
	  NeuralOS test suite for validating AI stack components.
	  
	  Includes tests for:
	  - emlearn headers
	  - OpenCV library
	  - NPIE library
	  - Hardware accelerators
	  - System resources
```

## package/neuraparse/npi-init/Config.in
```kconfig
config BR2_PACKAGE_NPI_INIT
	bool "npi-init (NeuralOS init system)"
	help
	  Build and install the NeuralOS init system (npi). This is a
	  lightweight init intended for embedded targets. By default it
	  installs to /usr/sbin and does not replace BusyBox init.
```

## package/neuraparse/npie/Config.in
```kconfig
config BR2_PACKAGE_NPIE
	bool "npie"
	depends on BR2_INSTALL_LIBSTDCPP
	depends on BR2_TOOLCHAIN_HAS_THREADS
	depends on !BR2_STATIC_LIBS
	help
	  NeuraParse Inference Engine (NPIE) is the core AI runtime
	  for NeuralOS. It provides a unified API for running AI models
	  across multiple backends (LiteRT, ONNX Runtime, emlearn) with
	  automatic hardware acceleration.

	  Features:
	  - Multi-backend support (LiteRT, ONNX, emlearn, WASM)
	  - Hardware acceleration (GPU, NPU, TPU)
	  - Real-time inference scheduling
	  - Model hot-swapping
	  - Performance profiling

	  https://neuraparse.com

if BR2_PACKAGE_NPIE

config BR2_PACKAGE_NPIE_EXAMPLES
	bool "Install example applications"
	default y
	help
	  Install example applications demonstrating NPIE usage.

endif

comment "npie needs a toolchain w/ C++, threads, dynamic library"
	depends on !BR2_INSTALL_LIBSTDCPP || !BR2_TOOLCHAIN_HAS_THREADS || BR2_STATIC_LIBS
```

## package/neuraparse/onnx-tools/Config.in
```kconfig
config BR2_PACKAGE_ONNX_TOOLS
	bool "onnx-tools"
	depends on BR2_PACKAGE_PYTHON3
	select BR2_PACKAGE_PYTHON_NUMPY
	help
	  ONNX (Open Neural Network Exchange) tools for model conversion,
	  optimization, and deployment.
	  
	  Features:
	  - Model conversion from PyTorch, TensorFlow, etc.
	  - Model optimization (quantization, pruning)
	  - Model validation and visualization
	  - ONNX Runtime integration
	  
	  https://github.com/onnx/onnx

comment "onnx-tools needs Python 3"
	depends on !BR2_PACKAGE_PYTHON3
```

## package/neuraparse/onnxruntime/Config.in
```kconfig
config BR2_PACKAGE_ONNXRUNTIME
	bool "onnxruntime"
	depends on BR2_INSTALL_LIBSTDCPP
	depends on BR2_TOOLCHAIN_HAS_THREADS
	depends on !BR2_STATIC_LIBS
	select BR2_PACKAGE_PROTOBUF
	select BR2_PACKAGE_FLATBUFFERS
	help
	  ONNX Runtime is a cross-platform, high performance ML
	  inferencing and training accelerator. It supports models
	  from PyTorch, TensorFlow, and other frameworks via ONNX.

	  https://onnxruntime.ai

if BR2_PACKAGE_ONNXRUNTIME

config BR2_PACKAGE_ONNXRUNTIME_OPENVINO
	bool "OpenVINO execution provider"
	help
	  Enable OpenVINO execution provider for Intel NPU/GPU
	  acceleration.

config BR2_PACKAGE_ONNXRUNTIME_TENSORRT
	bool "TensorRT execution provider"
	depends on BR2_aarch64
	help
	  Enable TensorRT execution provider for NVIDIA GPU
	  acceleration (Jetson platforms).

config BR2_PACKAGE_ONNXRUNTIME_ACL
	bool "ARM Compute Library execution provider"
	depends on BR2_aarch64 || BR2_arm
	help
	  Enable ARM Compute Library execution provider for
	  Mali GPU acceleration.

endif

comment "onnxruntime needs a toolchain w/ C++, threads, dynamic library"
	depends on !BR2_INSTALL_LIBSTDCPP || !BR2_TOOLCHAIN_HAS_THREADS || BR2_STATIC_LIBS
```

## package/neuraparse/opencv-minimal/Config.in
```kconfig
config BR2_PACKAGE_OPENCV_MINIMAL
	bool "opencv-minimal"
	depends on BR2_INSTALL_LIBSTDCPP
	depends on BR2_TOOLCHAIN_HAS_THREADS
	depends on !BR2_STATIC_LIBS
	help
	  OpenCV (Open Source Computer Vision Library) is an open source
	  computer vision and machine learning software library. This is
	  a minimal build optimized for embedded systems.

	  Features included:
	  - Core module (basic data structures)
	  - Image processing (imgproc)
	  - Image codecs (imgcodecs)
	  - Video I/O (videoio)
	  - DNN module (deep neural networks)

	  https://opencv.org

if BR2_PACKAGE_OPENCV_MINIMAL

config BR2_PACKAGE_OPENCV_MINIMAL_DNN
	bool "DNN module"
	default y
	help
	  Enable Deep Neural Networks (DNN) module for running
	  pre-trained models (Caffe, TensorFlow, ONNX, etc.)

config BR2_PACKAGE_OPENCV_MINIMAL_VIDEOIO
	bool "Video I/O support"
	default y
	help
	  Enable video capture and encoding/decoding support.

endif

comment "opencv-minimal needs a toolchain w/ C++, threads, dynamic library"
	depends on !BR2_INSTALL_LIBSTDCPP || !BR2_TOOLCHAIN_HAS_THREADS || BR2_STATIC_LIBS
```

## package/neuraparse/opencv5/Config.in
```kconfig
config BR2_PACKAGE_OPENCV5
	bool "opencv5"
	depends on BR2_INSTALL_LIBSTDCPP
	depends on BR2_TOOLCHAIN_HAS_THREADS
	depends on BR2_TOOLCHAIN_GCC_AT_LEAST_10
	help
	  OpenCV 5.0 - Next generation computer vision library.

	  New in OpenCV 5.0:
	  - C++17 minimum requirement
	  - Improved ARM/RISC-V support
	  - KleidiCV integration for ARM SIMD
	  - Better embedded system support
	  - Revised modern API

	  https://opencv.org/

if BR2_PACKAGE_OPENCV5

config BR2_PACKAGE_OPENCV5_DNN
	bool "Enable DNN module"
	default y
	help
	  Enable the Deep Neural Network module for AI inference.
	  Supports ONNX, TensorFlow, Caffe, and other formats.

config BR2_PACKAGE_OPENCV5_PYTHON
	bool "Enable Python bindings"
	depends on BR2_PACKAGE_PYTHON3
	help
	  Enable Python 3 bindings for OpenCV.

endif
```

## package/neuraparse/openvino/Config.in
```kconfig
config BR2_PACKAGE_OPENVINO
	bool "openvino"
	depends on BR2_INSTALL_LIBSTDCPP
	depends on BR2_TOOLCHAIN_HAS_THREADS
	depends on BR2_TOOLCHAIN_GCC_AT_LEAST_11
	help
	  Intel OpenVINO toolkit for optimizing and deploying
	  AI inference on Intel hardware and ARM.

	  Features:
	  - Model optimization and quantization
	  - Support for ONNX, TensorFlow, PyTorch models
	  - Intel CPU/GPU/NPU acceleration
	  - ARM CPU support via ARM Compute Library
	  - Low-latency inference

	  https://docs.openvino.ai/

if BR2_PACKAGE_OPENVINO

config BR2_PACKAGE_OPENVINO_NPU
	bool "Enable NPU support"
	help
	  Enable Intel Neural Processing Unit support for
	  dedicated AI acceleration.

config BR2_PACKAGE_OPENVINO_PYTHON
	bool "Enable Python bindings"
	depends on BR2_PACKAGE_PYTHON3
	select BR2_PACKAGE_PYTHON_NUMPY
	help
	  Enable Python bindings for OpenVINO inference API.

endif
```

## package/neuraparse/orb-slam3/Config.in
```kconfig
config BR2_PACKAGE_ORB_SLAM3
	bool "orb-slam3"
	depends on BR2_INSTALL_LIBSTDCPP
	depends on BR2_TOOLCHAIN_HAS_THREADS
	depends on !BR2_STATIC_LIBS
	select BR2_PACKAGE_OPENCV_MINIMAL
	select BR2_PACKAGE_EIGEN
	help
	  ORB-SLAM3 is a real-time SLAM library for Monocular, Stereo
	  and RGB-D cameras that computes the camera trajectory and a
	  sparse 3D reconstruction.
	  
	  Features:
	  - Visual, Visual-Inertial and Multi-Map SLAM
	  - Monocular, Stereo, RGB-D and Fisheye cameras
	  - Real-time performance
	  - Loop closing and relocalization
	  - Map reuse and merging
	  
	  https://github.com/UZ-SLAMLab/ORB_SLAM3

if BR2_PACKAGE_ORB_SLAM3

config BR2_PACKAGE_ORB_SLAM3_VIEWER
	bool "Enable Pangolin viewer"
	help
	  Enable Pangolin-based 3D visualization viewer.

endif

comment "orb-slam3 needs a toolchain w/ C++, threads, dynamic library"
	depends on !BR2_INSTALL_LIBSTDCPP || !BR2_TOOLCHAIN_HAS_THREADS || BR2_STATIC_LIBS
```

## package/neuraparse/pennylane/Config.in
```kconfig
config BR2_PACKAGE_PENNYLANE
	bool "pennylane"
	depends on BR2_INSTALL_LIBSTDCPP
	depends on BR2_TOOLCHAIN_HAS_THREADS
	depends on BR2_PACKAGE_PYTHON3
	select BR2_PACKAGE_PYTHON_NUMPY
	help
	  PennyLane - Quantum Machine Learning Library

	  PennyLane is a cross-platform Python library for quantum
	  machine learning, automatic differentiation, and optimization
	  of hybrid quantum-classical computations.

	  Key Features:
	  - Hybrid quantum-classical workflows
	  - Automatic differentiation of quantum circuits
	  - Support for multiple quantum hardware backends
	  - Integration with PyTorch, TensorFlow, JAX
	  - Built-in quantum chemistry support
	  - Device-agnostic programming

	  Supported Backends:
	  - PennyLane Lightning (high-perf C++ simulator)
	  - IBM Qiskit
	  - Google Cirq
	  - AWS Braket
	  - IonQ, Rigetti, and more

	  https://pennylane.ai

if BR2_PACKAGE_PENNYLANE

config BR2_PACKAGE_PENNYLANE_LIGHTNING
	bool "PennyLane Lightning (fast C++ simulator)"
	default y
	help
	  Enable PennyLane Lightning - a fast state-vector quantum
	  simulator written in C++ with OpenMP parallelization.

config BR2_PACKAGE_PENNYLANE_LIGHTNING_GPU
	bool "Lightning GPU (CUDA acceleration)"
	depends on BR2_PACKAGE_PENNYLANE_LIGHTNING
	help
	  Enable GPU-accelerated simulation using CUDA.

endif
```

## package/neuraparse/piper-tts/Config.in
```kconfig
config BR2_PACKAGE_PIPER_TTS
	bool "piper-tts"
	depends on BR2_INSTALL_LIBSTDCPP
	depends on BR2_TOOLCHAIN_HAS_THREADS
	help
	  Piper - Fast, local neural text-to-speech system

	  Piper is a fast, local neural text-to-speech system that
	  sounds great and is optimized for embedded devices like
	  Raspberry Pi 4.

	  Key Features:
	  - Completely offline TTS
	  - Low latency, real-time synthesis
	  - Multiple voices and languages
	  - ONNX Runtime backend
	  - Optimized for ARM and x86
	  - eSpeak-ng phonemization
	  - SSML support

	  Performance:
	  - Raspberry Pi 4: ~1.5x real-time
	  - Desktop CPU: ~10-20x real-time
	  - GPU: ~100x real-time

	  Voices available for 30+ languages including
	  English, German, French, Spanish, Chinese, etc.

	  https://github.com/rhasspy/piper

if BR2_PACKAGE_PIPER_TTS

config BR2_PACKAGE_PIPER_TTS_PHONEMIZE
	bool "Include phonemization support"
	default y
	select BR2_PACKAGE_ESPEAK_NG
	help
	  Enable text phonemization using espeak-ng for
	  better pronunciation accuracy.

endif
```

## package/neuraparse/px4-autopilot/Config.in
```kconfig
config BR2_PACKAGE_PX4_AUTOPILOT
	bool "px4-autopilot"
	depends on BR2_INSTALL_LIBSTDCPP
	depends on BR2_TOOLCHAIN_HAS_THREADS
	select BR2_PACKAGE_MAVLINK
	help
	  PX4 is the Professional Autopilot for drones. Powers all
	  kinds of vehicles from racing and cargo drones through to
	  ground vehicles and submersibles.

	  Features:
	  - Open-source flight control solution
	  - MAVLink communication protocol
	  - ROS 2 integration support
	  - SITL and HITL simulation
	  - Hardware support: Pixhawk, CUAV, Holybro, etc.

	  https://px4.io/

if BR2_PACKAGE_PX4_AUTOPILOT

config BR2_PACKAGE_PX4_AUTOPILOT_ROS2
	bool "Enable ROS2 integration (requires Fast-DDS)"
	depends on BR2_PACKAGE_FAST_DDS
	help
	  Enable ROS 2 middleware integration for advanced
	  robotics applications using Fast-DDS.

config BR2_PACKAGE_PX4_AUTOPILOT_SIMULATION
	bool "Enable simulation support"
	help
	  Enable SITL (Software In The Loop) simulation
	  for development and testing.

endif
```

## package/neuraparse/pytorch-executorch/Config.in
```kconfig
config BR2_PACKAGE_PYTORCH_EXECUTORCH
	bool "pytorch-executorch"
	depends on BR2_INSTALL_LIBSTDCPP
	depends on BR2_TOOLCHAIN_HAS_THREADS
	depends on BR2_USE_WCHAR
	select BR2_PACKAGE_FLATBUFFERS
	help
	  ExecuTorch is PyTorch's solution for efficient AI inference
	  on edge devices - from mobile phones to embedded systems.

	  ExecuTorch provides:
	  - Portability across diverse hardware
	  - Productivity via PyTorch ecosystem integration
	  - Performance optimized for edge devices
	  - Support for quantization and model optimization

	  https://github.com/pytorch/executorch

if BR2_PACKAGE_PYTORCH_EXECUTORCH

config BR2_PACKAGE_PYTORCH_EXECUTORCH_XNNPACK
	bool "XNNPACK backend"
	default y
	help
	  Enable XNNPACK backend for optimized CPU inference

config BR2_PACKAGE_PYTORCH_EXECUTORCH_VULKAN
	bool "Vulkan backend"
	help
	  Enable Vulkan backend for GPU acceleration

config BR2_PACKAGE_PYTORCH_EXECUTORCH_COREML
	bool "CoreML backend"
	depends on BR2_PACKAGE_HAS_COREML
	help
	  Enable CoreML backend for Apple hardware

endif
```

## package/neuraparse/qiskit-aer/Config.in
```kconfig
config BR2_PACKAGE_QISKIT_AER
	bool "qiskit-aer"
	depends on BR2_INSTALL_LIBSTDCPP
	depends on BR2_TOOLCHAIN_HAS_THREADS
	depends on BR2_PACKAGE_PYTHON3
	select BR2_PACKAGE_PYTHON_NUMPY
	help
	  Qiskit Aer - High performance quantum computing simulators
	  with realistic noise models.

	  Qiskit Aer provides high-performance quantum circuit simulation
	  for Qiskit. It includes multiple simulation methods:
	  - Statevector: Full wavefunction simulation
	  - Density matrix: Noisy quantum simulation
	  - Matrix Product State (MPS): Efficient simulation
	  - Stabilizer: Clifford circuit simulation
	  - Extended stabilizer: Near-Clifford simulation

	  Key Features:
	  - GPU acceleration (CUDA, ROCm)
	  - Multi-threading with OpenMP
	  - Realistic noise models
	  - Pulse-level simulation

	  https://github.com/Qiskit/qiskit-aer

if BR2_PACKAGE_QISKIT_AER

config BR2_PACKAGE_QISKIT_AER_GPU
	bool "GPU acceleration (CUDA)"
	help
	  Enable CUDA GPU acceleration for quantum simulation.
	  Requires NVIDIA GPU with CUDA support.

config BR2_PACKAGE_QISKIT_AER_MPI
	bool "MPI support for distributed simulation"
	select BR2_PACKAGE_OPENMPI
	help
	  Enable MPI for distributed quantum simulation
	  across multiple nodes.

endif
```

## package/neuraparse/quest/Config.in
```kconfig
config BR2_PACKAGE_QUEST
	bool "quest"
	help
	  QuEST (Quantum Exact Simulation Toolkit) is a high-performance
	  quantum computer simulator with zero external dependencies.

	  Features:
	  - Pure C implementation with C++ wrappers
	  - Zero mandatory dependencies
	  - Supports OpenMP multithreading
	  - Supports MPI distributed computing
	  - Over 140 quantum operations
	  - Configurable numerical precision

	  Ideal for embedded systems due to minimal footprint.

	  https://quest.qtechtheory.org/
```
