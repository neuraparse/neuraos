## package/neuraparse/apache-tvm/Config.in
```kconfig
config BR2_PACKAGE_APACHE_TVM
	bool "apache-tvm"
	depends on BR2_INSTALL_LIBSTDCPP
	depends on BR2_TOOLCHAIN_HAS_THREADS
	depends on BR2_USE_WCHAR
	select BR2_PACKAGE_LLVM
	select BR2_PACKAGE_PYTHON3
	help
	  Apache TVM is an open deep learning compiler stack for CPUs,
	  GPUs, and specialized accelerators. It aims to close the gap
	  between the productivity-focused deep learning frameworks and
	  the performance- or efficiency-oriented hardware backends.

	  TVM provides:
	  - End-to-end compilation from deep learning frameworks
	  - Automated optimization for diverse hardware backends
	  - Support for CPUs, GPUs, and specialized accelerators
	  - Cross-level design with TensorIR and Relax

	  https://github.com/apache/tvm

if BR2_PACKAGE_APACHE_TVM

config BR2_PACKAGE_APACHE_TVM_LLVM_BACKEND
	bool "LLVM backend"
	default y
	help
	  Enable LLVM backend for CPU code generation

config BR2_PACKAGE_APACHE_TVM_OPENCL_BACKEND
	bool "OpenCL backend"
	help
	  Enable OpenCL backend for GPU acceleration

config BR2_PACKAGE_APACHE_TVM_VULKAN_BACKEND
	bool "Vulkan backend"
	help
	  Enable Vulkan backend for GPU acceleration

endif
```

## package/neuraparse/ardupilot/Config.in
```kconfig
config BR2_PACKAGE_ARDUPILOT
	bool "ardupilot"
	depends on BR2_INSTALL_LIBSTDCPP
	depends on BR2_TOOLCHAIN_HAS_THREADS
	select BR2_PACKAGE_MAVLINK
	help
	  ArduPilot - Open Source Autopilot

	  ArduPilot is a trusted, versatile, and open source autopilot
	  system supporting multi-copters, helicopters, fixed-wing
	  aircraft, rovers, boats, and submarines.

	  Key Features:
	  - Supports 20+ vehicle types
	  - Advanced flight modes (Auto, Guided, RTL, etc.)
	  - Terrain following
	  - Object avoidance
	  - Precision landing
	  - Companion computer integration
	  - Lua scripting support
	  - EKF3 state estimation
	  - MAVLink 2.0 support

	  Vehicle Types:
	  - Copter: Multi-rotors, helicopters
	  - Plane: Fixed-wing aircraft
	  - Rover: Ground vehicles
	  - Sub: Underwater vehicles
	  - Blimp: Lighter-than-air vehicles

	  Hardware Support:
	  - Pixhawk family
	  - CubePilot
	  - Holybro
	  - mRobotics
	  - BeagleBone Blue
	  - Linux-based companions

	  https://ardupilot.org

if BR2_PACKAGE_ARDUPILOT

choice
	prompt "Vehicle type"
	default BR2_PACKAGE_ARDUPILOT_COPTER

config BR2_PACKAGE_ARDUPILOT_COPTER
	bool "ArduCopter (multi-rotor)"
	help
	  ArduCopter for multi-rotor and helicopter vehicles.

config BR2_PACKAGE_ARDUPILOT_PLANE
	bool "ArduPlane (fixed-wing)"
	help
	  ArduPlane for fixed-wing aircraft.

config BR2_PACKAGE_ARDUPILOT_ROVER
	bool "ArduRover (ground vehicle)"
	help
	  ArduRover for ground vehicles and boats.

config BR2_PACKAGE_ARDUPILOT_SUB
	bool "ArduSub (underwater)"
	help
	  ArduSub for underwater vehicles/ROVs.

endchoice

config BR2_PACKAGE_ARDUPILOT_SITL
	bool "SITL simulation support"
	help
	  Enable Software-In-The-Loop simulation for testing.

config BR2_PACKAGE_ARDUPILOT_LUA
	bool "Lua scripting support"
	default y
	help
	  Enable Lua scripting for custom behaviors.

endif
```

## package/neuraparse/asio/Config.in
```kconfig
config BR2_PACKAGE_ASIO
	bool "asio"
	depends on BR2_INSTALL_LIBSTDCPP
	help
	  Asio is a cross-platform C++ library for network and
	  low-level I/O programming that provides developers with a
	  consistent asynchronous model.

	  This is the standalone (header-only) version.

	  https://think-async.com/Asio/
```

## package/neuraparse/defense-tools/Config.in
```kconfig
config BR2_PACKAGE_DEFENSE_TOOLS
	bool "defense-tools"
	help
	  Defense and Security Tools for Embedded Systems

	  A collection of security and defense tools for embedded
	  systems, drones, and robotic platforms.

	  Components include:
	  - Network security monitoring
	  - Intrusion detection
	  - Secure communications
	  - Encryption utilities
	  - Vulnerability assessment

	  This is a meta-package that selects commonly needed
	  security tools for defense applications.

if BR2_PACKAGE_DEFENSE_TOOLS

config BR2_PACKAGE_DEFENSE_TOOLS_NETWORK
	bool "Network security tools"
	default y
	select BR2_PACKAGE_TCPDUMP
	select BR2_PACKAGE_IPTABLES
	select BR2_PACKAGE_NFTABLES
	help
	  Network monitoring and security tools.
	  - tcpdump: Packet analyzer
	  - iptables/nftables: Firewall

config BR2_PACKAGE_DEFENSE_TOOLS_CRYPTO
	bool "Cryptography tools"
	default y
	select BR2_PACKAGE_OPENSSL
	select BR2_PACKAGE_GNUPG2
	help
	  Encryption and cryptography tools.
	  - OpenSSL: SSL/TLS and crypto library
	  - GnuPG: OpenPGP implementation

config BR2_PACKAGE_DEFENSE_TOOLS_IDS
	bool "Intrusion detection"
	select BR2_PACKAGE_SNORT
	help
	  Intrusion detection and prevention.
	  - Snort: Network IDS/IPS

config BR2_PACKAGE_DEFENSE_TOOLS_AUDIT
	bool "Security auditing"
	select BR2_PACKAGE_AUDIT
	help
	  System security auditing tools.
	  - Linux Audit framework

config BR2_PACKAGE_DEFENSE_TOOLS_SECURE_BOOT
	bool "Secure boot support"
	help
	  Tools for secure boot and verified boot.

endif
```

## package/neuraparse/emlearn/Config.in
```kconfig
config BR2_PACKAGE_EMLEARN
	bool "emlearn"
	help
	  emlearn is an efficient Machine Learning inference engine
	  for microcontrollers and embedded systems. It supports
	  classical ML models (Random Forest, SVM, Neural Networks)
	  with extremely small binary sizes (50-200 KB).

	  Features:
	  - Header-only C library
	  - No dependencies
	  - Supports scikit-learn and Keras models
	  - Optimized for ARM Cortex-M and similar MCUs

	  https://emlearn.org
```

## package/neuraparse/fast-dds/Config.in
```kconfig
config BR2_PACKAGE_FAST_DDS
	bool "fast-dds"
	depends on BR2_INSTALL_LIBSTDCPP
	depends on BR2_TOOLCHAIN_HAS_THREADS
	depends on !BR2_STATIC_LIBS
	select BR2_PACKAGE_OPENSSL
	help
	  eProsima Fast DDS (formerly Fast RTPS) is a C++ implementation
	  of the DDS (Data Distribution Service) specification of the OMG.
	  
	  Fast DDS provides:
	  - Real-time publish-subscribe communication
	  - Quality of Service (QoS) policies
	  - Discovery mechanisms
	  - Security features (DDS Security)
	  - High performance and low latency
	  
	  Used by ROS 2 as default middleware for robotics applications.
	  
	  https://github.com/eProsima/Fast-DDS

if BR2_PACKAGE_FAST_DDS

config BR2_PACKAGE_FAST_DDS_SECURITY
	bool "DDS Security support"
	default y
	help
	  Enable DDS Security features for secure communication.

config BR2_PACKAGE_FAST_DDS_SHM
	bool "Shared memory transport"
	default y
	help
	  Enable shared memory transport for high-performance
	  local communication.

endif

comment "fast-dds needs a toolchain w/ C++, threads, dynamic library"
	depends on !BR2_INSTALL_LIBSTDCPP || !BR2_TOOLCHAIN_HAS_THREADS || BR2_STATIC_LIBS
```

## package/neuraparse/fastcdr/Config.in
```kconfig
config BR2_PACKAGE_FASTCDR
	bool "fastcdr"
	depends on BR2_INSTALL_LIBSTDCPP
	help
	  Fast CDR serialization library for eProsima Fast DDS.

	  https://github.com/eProsima/Fast-CDR
```

## package/neuraparse/foonathan-memory/Config.in
```kconfig
config BR2_PACKAGE_FOONATHAN_MEMORY
	bool "foonathan-memory"
	depends on BR2_INSTALL_LIBSTDCPP
	help
	  foonathan/memory is a memory allocator library used by
	  eProsima Fast-DDS.

	  https://github.com/eProsima/foonathan_memory_vendor
```

## package/neuraparse/grpc/Config.in
```kconfig
config BR2_PACKAGE_GRPC
	bool "grpc"
	depends on BR2_INSTALL_LIBSTDCPP
	depends on BR2_TOOLCHAIN_HAS_THREADS
	depends on !BR2_STATIC_LIBS
	select BR2_PACKAGE_PROTOBUF
	select BR2_PACKAGE_OPENSSL
	select BR2_PACKAGE_ZLIB
	select BR2_PACKAGE_C_ARES
	help
	  gRPC is a modern open source high performance Remote Procedure
	  Call (RPC) framework that can run in any environment.
	  
	  Features:
	  - Simple service definition using Protocol Buffers
	  - Works across languages and platforms
	  - Bi-directional streaming and integrated auth
	  - Pluggable load balancing, tracing, health checking
	  
	  https://grpc.io

comment "grpc needs a toolchain w/ C++, threads, dynamic library"
	depends on !BR2_INSTALL_LIBSTDCPP || !BR2_TOOLCHAIN_HAS_THREADS || BR2_STATIC_LIBS
```

## package/neuraparse/litert/Config.in
```kconfig
config BR2_PACKAGE_LITERT
	bool "litert"
	depends on BR2_INSTALL_LIBSTDCPP
	depends on BR2_TOOLCHAIN_HAS_THREADS
	depends on !BR2_STATIC_LIBS
	select BR2_PACKAGE_FLATBUFFERS
	help
	  LiteRT (formerly TensorFlow Lite) is Google's high-performance
	  runtime for on-device AI. It enables running machine learning
	  models on mobile and embedded devices with low latency and
	  small binary size.

	  https://ai.google.dev/edge/litert

if BR2_PACKAGE_LITERT

config BR2_PACKAGE_LITERT_XNNPACK
	bool "XNNPACK delegate"
	default y
	help
	  Enable XNNPACK delegate for optimized inference on ARM NEON
	  and x86 AVX processors.

config BR2_PACKAGE_LITERT_GPU_DELEGATE
	bool "GPU delegate"
	depends on BR2_PACKAGE_HAS_LIBGLES
	select BR2_PACKAGE_MESA3D
	select BR2_PACKAGE_LIBDRM
	help
	  Enable GPU delegate for hardware-accelerated inference
	  using OpenGL ES or Vulkan.

config BR2_PACKAGE_LITERT_NNAPI_DELEGATE
	bool "NNAPI delegate"
	help
	  Enable NNAPI (Neural Networks API) delegate for NPU
	  acceleration on supported platforms.

endif

comment "litert needs a toolchain w/ C++, threads, dynamic library"
	depends on !BR2_INSTALL_LIBSTDCPP || !BR2_TOOLCHAIN_HAS_THREADS || BR2_STATIC_LIBS
```

## package/neuraparse/llama-cpp/Config.in
```kconfig
config BR2_PACKAGE_LLAMA_CPP
	bool "llama-cpp"
	depends on BR2_INSTALL_LIBSTDCPP
	depends on BR2_TOOLCHAIN_HAS_THREADS
	depends on BR2_USE_WCHAR
	help
	  LLM inference in C/C++. Efficient inference of large language
	  models (LLMs) on consumer hardware with minimal dependencies.

	  llama.cpp provides:
	  - Pure C/C++ implementation with no dependencies
	  - Optimized for Apple Silicon, x86, ARM NEON, RISC-V
	  - Support for GGUF model format
	  - Quantization support (4-bit, 5-bit, 8-bit)
	  - KleidiAI integration for ARM optimization

	  https://github.com/ggml-org/llama.cpp

if BR2_PACKAGE_LLAMA_CPP

config BR2_PACKAGE_LLAMA_CPP_OPENCL
	bool "OpenCL backend"
	help
	  Enable OpenCL backend for GPU acceleration

config BR2_PACKAGE_LLAMA_CPP_VULKAN
	bool "Vulkan backend"
	help
	  Enable Vulkan backend for GPU acceleration

config BR2_PACKAGE_LLAMA_CPP_METAL
	bool "Metal backend"
	depends on BR2_PACKAGE_HAS_METAL
	help
	  Enable Metal backend for Apple GPU acceleration

endif
```

## package/neuraparse/mavlink/Config.in
```kconfig
config BR2_PACKAGE_MAVLINK
	bool "mavlink"
	help
	  MAVLink (Micro Air Vehicle Link) is a lightweight messaging
	  protocol for communicating with drones and between onboard
	  drone components.
	  
	  Features:
	  - Lightweight and efficient binary protocol
	  - Used by PX4, ArduPilot, and other autopilots
	  - Support for multiple vehicles and systems
	  - Extensible message definitions
	  - C, C++, Python, and other language bindings
	  
	  https://mavlink.io

if BR2_PACKAGE_MAVLINK

config BR2_PACKAGE_MAVLINK_V2
	bool "MAVLink v2 protocol"
	default y
	help
	  Enable MAVLink v2 protocol with signing and extensions.

endif
```

## package/neuraparse/mavsdk/Config.in
```kconfig
config BR2_PACKAGE_MAVSDK
	bool "mavsdk"
	depends on BR2_INSTALL_LIBSTDCPP
	depends on BR2_TOOLCHAIN_HAS_THREADS
	select BR2_PACKAGE_MAVLINK
	select BR2_PACKAGE_JSONCPP
	select BR2_PACKAGE_TINYXML2
	select BR2_PACKAGE_XZ
	help
	  MAVSDK - MAVLink SDK for drones and robotics

	  MAVSDK is the modern SDK for MAVLink, providing easy-to-use
	  APIs for controlling drones and other MAVLink-enabled vehicles.

	  Key Features:
	  - Clean, simple API for drone control
	  - Multiple language bindings (C++, Python, Swift, Java)
	  - Automatic connection handling
	  - Mission planning and execution
	  - Telemetry data streaming
	  - Camera and gimbal control
	  - Geofencing support
	  - Follow-me mode
	  - Offboard control for custom flight modes

	  Supported Autopilots:
	  - PX4
	  - ArduPilot
	  - Any MAVLink-compatible system

	  Use Cases:
	  - Autonomous drone applications
	  - Ground control stations
	  - Swarm coordination
	  - Computer vision integration
	  - Research and development

	  https://mavsdk.mavlink.io

if BR2_PACKAGE_MAVSDK

config BR2_PACKAGE_MAVSDK_PYTHON
	bool "Python bindings"
	depends on BR2_PACKAGE_PYTHON3
	help
	  Enable Python bindings for MAVSDK.

config BR2_PACKAGE_MAVSDK_SERVER
	bool "MAVSDK Server"
	default y
	help
	  Build MAVSDK server for gRPC-based communication.

endif
```

## package/neuraparse/mediapipe/Config.in
```kconfig
config BR2_PACKAGE_MEDIAPIPE
	bool "mediapipe"
	depends on BR2_INSTALL_LIBSTDCPP
	depends on BR2_TOOLCHAIN_HAS_THREADS
	depends on BR2_USE_WCHAR
	select BR2_PACKAGE_OPENCV_MINIMAL
	select BR2_PACKAGE_PROTOBUF
	help
	  MediaPipe is a cross-platform framework for building multimodal
	  applied machine learning pipelines. It provides ready-to-use
	  ML solutions for face detection, hand tracking, pose estimation,
	  object detection, and more.

	  MediaPipe provides:
	  - Real-time multimodal AI pipelines
	  - Cross-platform support (Android, iOS, Web, Desktop)
	  - Pre-built ML solutions for vision, audio, and text
	  - Optimized for on-device inference

	  https://github.com/google-ai-edge/mediapipe

if BR2_PACKAGE_MEDIAPIPE

config BR2_PACKAGE_MEDIAPIPE_GPU
	bool "GPU support"
	help
	  Enable GPU acceleration for MediaPipe

config BR2_PACKAGE_MEDIAPIPE_AUDIO
	bool "Audio support"
	help
	  Enable audio processing capabilities

endif
```
