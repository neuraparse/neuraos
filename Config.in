## configs/kernel/neuraos_x86_64_defconfig
```kconfig
# NeuralOS Kernel Config - Linux 6.12 LTS for x86_64
# Optimized for KVM virtualization

CONFIG_X86_64=y
CONFIG_64BIT=y
CONFIG_SMP=y
CONFIG_NR_CPUS=64

# KVM guest support (critical for performance)
CONFIG_HYPERVISOR_GUEST=y
CONFIG_PARAVIRT=y
CONFIG_KVM_GUEST=y
CONFIG_PARAVIRT_TIME_ACCOUNTING=y
CONFIG_PARAVIRT_CLOCK=y

# Real-time preemption (native in 6.12 LTS!)
CONFIG_PREEMPT_RT=y
CONFIG_PREEMPT_COUNT=y
CONFIG_PREEMPTION=y
CONFIG_LOCALVERSION="-neuraos-rt"

# High-resolution timers for real-time
CONFIG_HIGH_RES_TIMERS=y
CONFIG_NO_HZ_FULL=y
CONFIG_HZ_1000=y

# Networking
CONFIG_NET=y
CONFIG_INET=y
CONFIG_IP_PNP=y
CONFIG_IP_PNP_DHCP=y
CONFIG_PACKET=y
CONFIG_UNIX=y

# PCI support
CONFIG_PCI=y

# Block devices
CONFIG_BLK_DEV_LOOP=y
CONFIG_BLK_DEV_RAM=y
CONFIG_SCSI=y
CONFIG_BLK_DEV_SD=y

# Virtio drivers (built-in for KVM)
CONFIG_VIRTIO=y
CONFIG_VIRTIO_BLK=y
CONFIG_VIRTIO_NET=y
CONFIG_VIRTIO_PCI=y
CONFIG_VIRTIO_MMIO=y
CONFIG_VIRTIO_CONSOLE=y
CONFIG_HW_RANDOM_VIRTIO=y
CONFIG_VIRTIO_BALLOON=y

# Network drivers
CONFIG_NETDEVICES=y
CONFIG_NET_CORE=y
CONFIG_VIRTIO_NET=y

# Serial console (for QEMU -nographic)
CONFIG_SERIAL_8250=y
CONFIG_SERIAL_8250_CONSOLE=y

# Filesystems
CONFIG_EXT4_FS=y
CONFIG_PROC_FS=y
CONFIG_SYSFS=y
CONFIG_TMPFS=y
CONFIG_DEVTMPFS=y
CONFIG_DEVTMPFS_MOUNT=y

# Essential
CONFIG_BINFMT_ELF=y
CONFIG_BINFMT_SCRIPT=y

# Kernel compression (faster boot)
CONFIG_KERNEL_GZIP=y

# Initial ramdisk support
CONFIG_BLK_DEV_INITRD=y

# EFI support (optional, for bare-metal)
CONFIG_EFI=y
CONFIG_EFI_STUB=y
```

## configs/neuraos_defconfig
```kconfig
#
# NeuralOS Buildroot Configuration (2025.08 LTS)
# Target: Multi-architecture AI-native embedded system
# Updated: October 2025
#

#
# Target Architecture
#
# Default: ARM 64-bit (can be overridden by board-specific configs)
BR2_aarch64=y
BR2_cortex_a53=y
BR2_ARM_FPU_VFPV4=y
BR2_ARM_INSTRUCTIONS_THUMB2=y

#
# Build Options
#
BR2_CCACHE=y
BR2_CCACHE_DIR="$(HOME)/.buildroot-ccache"
BR2_ENABLE_DEBUG=y
BR2_OPTIMIZE_2=y
BR2_SHARED_STATIC_LIBS=y
BR2_COMPILER_PARANOID_UNSAFE_PATH=y

#
# Toolchain
#
BR2_TOOLCHAIN_BUILDROOT=y
BR2_TOOLCHAIN_BUILDROOT_GLIBC=n
BR2_TOOLCHAIN_BUILDROOT_MUSL=y
BR2_TOOLCHAIN_BUILDROOT_CXX=y
BR2_TOOLCHAIN_BUILDROOT_FORTRAN=n
BR2_GCC_VERSION_13_X=y
BR2_TOOLCHAIN_BUILDROOT_WCHAR=y
BR2_TOOLCHAIN_BUILDROOT_LOCALE=y
BR2_TOOLCHAIN_BUILDROOT_USE_SSP=y
BR2_TOOLCHAIN_BUILDROOT_CXX_FULL=y

#
# Kernel
#
BR2_LINUX_KERNEL=y
BR2_LINUX_KERNEL_CUSTOM_VERSION=y
BR2_LINUX_KERNEL_CUSTOM_VERSION_VALUE="6.12.8"
BR2_LINUX_KERNEL_USE_CUSTOM_CONFIG=y
BR2_LINUX_KERNEL_CUSTOM_CONFIG_FILE="$(BR2_EXTERNAL_NEURAOS_PATH)/configs/kernel/neuraos_6.12_defconfig"
BR2_LINUX_KERNEL_ZIMAGE=y
BR2_LINUX_KERNEL_DTS_SUPPORT=y
BR2_LINUX_KERNEL_INTREE_DTS_NAME="broadcom/bcm2711-rpi-4-b"
BR2_LINUX_KERNEL_NEEDS_HOST_OPENSSL=y
BR2_LINUX_KERNEL_NEEDS_HOST_LIBELF=y

#
# Kernel Extensions
#
BR2_LINUX_KERNEL_EXT_PREEMPT_RT=y
BR2_PACKAGE_LINUX_TOOLS_PERF=y
BR2_PACKAGE_LINUX_TOOLS_BPF=y

#
# Bootloader
#
BR2_TARGET_UBOOT=y
BR2_TARGET_UBOOT_BUILD_SYSTEM_KCONFIG=y
BR2_TARGET_UBOOT_CUSTOM_VERSION=y
BR2_TARGET_UBOOT_CUSTOM_VERSION_VALUE="2025.01"
BR2_TARGET_UBOOT_BOARD_DEFCONFIG="rpi_4"
BR2_TARGET_UBOOT_NEEDS_DTC=y
BR2_TARGET_UBOOT_NEEDS_PYLIBFDT=y
BR2_TARGET_UBOOT_NEEDS_OPENSSL=y
BR2_TARGET_UBOOT_FORMAT_BIN=y

#
# System Configuration
#
BR2_TARGET_GENERIC_HOSTNAME="neuraos"
BR2_TARGET_GENERIC_ISSUE="Welcome to NeuralOS v1.0.0-alpha"
BR2_ROOTFS_DEVICE_CREATION_DYNAMIC_EUDEV=y
BR2_TARGET_GENERIC_ROOT_PASSWD="neuraos"
BR2_SYSTEM_DHCP="eth0"
BR2_ROOTFS_OVERLAY="$(BR2_EXTERNAL_NEURAOS_PATH)/board/neuraparse/neuraos/rootfs_overlay"
BR2_ROOTFS_POST_BUILD_SCRIPT="$(BR2_EXTERNAL_NEURAOS_PATH)/board/neuraparse/neuraos/scripts/post_build.sh"
BR2_ROOTFS_POST_IMAGE_SCRIPT="$(BR2_EXTERNAL_NEURAOS_PATH)/board/neuraparse/neuraos/scripts/post_image.sh"

#
# Init System - Custom NeuralOS Init (npi)
#
BR2_INIT_BUSYBOX=y
BR2_ROOTFS_DEVICE_CREATION_DYNAMIC_EUDEV=y

#
# BusyBox Configuration
#
BR2_PACKAGE_BUSYBOX=y
BR2_PACKAGE_BUSYBOX_SHOW_OTHERS=y

#
# Core System Packages
#
BR2_PACKAGE_GLIBC_UTILS=n
BR2_PACKAGE_MUSL=y

#
# Compression and Archiving
#
BR2_PACKAGE_BZIP2=y
BR2_PACKAGE_GZIP=y
BR2_PACKAGE_XZ=y
BR2_PACKAGE_ZLIB=y
BR2_PACKAGE_ZSTD=y
BR2_PACKAGE_LZ4=y

#
# Filesystem and Storage
#
BR2_PACKAGE_E2FSPROGS=y
BR2_PACKAGE_SQUASHFS=y
BR2_PACKAGE_F2FS_TOOLS=y
BR2_PACKAGE_MTD=y

#
# Networking Packages
#
BR2_PACKAGE_DROPBEAR=y
BR2_PACKAGE_DROPBEAR_DISABLE_REVERSEDNS=y
BR2_PACKAGE_DROPBEAR_SMALL=y
BR2_PACKAGE_IPTABLES=y
BR2_PACKAGE_NFTABLES=y
BR2_PACKAGE_IPROUTE2=y
BR2_PACKAGE_ETHTOOL=y
BR2_PACKAGE_WIRELESS_TOOLS=y
BR2_PACKAGE_WPA_SUPPLICANT=y
BR2_PACKAGE_WPA_SUPPLICANT_CLI=y
BR2_PACKAGE_BLUEZ5_UTILS=y
BR2_PACKAGE_MOSQUITTO=y
BR2_PACKAGE_LIBCURL=y
BR2_PACKAGE_LIBCURL_CURL=y
BR2_PACKAGE_MBEDTLS=y

#
# eBPF/XDP Support (Modern 2025 Networking)
#
BR2_PACKAGE_LIBBPF=y
BR2_PACKAGE_BPFTOOL=y
BR2_PACKAGE_BCC=y

#
# Development Tools
#
BR2_PACKAGE_GDB=y
BR2_PACKAGE_GDB_SERVER=y
BR2_PACKAGE_STRACE=y
BR2_PACKAGE_LTRACE=y
BR2_PACKAGE_VALGRIND=y
BR2_PACKAGE_PERF=y

#
# Libraries
#
BR2_PACKAGE_LIBPTHREAD_STUBS=y
BR2_PACKAGE_LIBATOMIC_OPS=y
BR2_PACKAGE_BOOST=y
BR2_PACKAGE_BOOST_FILESYSTEM=y
BR2_PACKAGE_BOOST_SYSTEM=y
BR2_PACKAGE_PROTOBUF=y
BR2_PACKAGE_FLATBUFFERS=y
BR2_PACKAGE_JSON_C=y
BR2_PACKAGE_JSONCPP=y
BR2_PACKAGE_YAML_CPP=y

#
# AI/ML Frameworks (2025 Edition)
#
# LiteRT (formerly TensorFlow Lite)
BR2_PACKAGE_LITERT=y
BR2_PACKAGE_LITERT_XNNPACK=y
BR2_PACKAGE_LITERT_GPU_DELEGATE=y
BR2_PACKAGE_LITERT_NNAPI_DELEGATE=y

# ONNX Runtime
BR2_PACKAGE_ONNXRUNTIME=y
BR2_PACKAGE_ONNXRUNTIME_OPENVINO=y
BR2_PACKAGE_ONNXRUNTIME_TENSORRT=n

# emlearn (Classical ML)
BR2_PACKAGE_EMLEARN=y

# OpenCV (optional)
# Use Buildroot's standard OpenCV if needed; disabled by default
# BR2_PACKAGE_OPENCV4=y

#
# WebAssembly Runtime (2025 Addition)
#
BR2_PACKAGE_WASMEDGE=y
BR2_PACKAGE_WASMEDGE_PLUGINS=y
BR2_PACKAGE_WASMEDGE_WASI_NN=y

#
# NeuraParse Custom Packages
#
BR2_PACKAGE_NPIE=y
BR2_PACKAGE_NPI_INIT=y
BR2_PACKAGE_NEURAOS_DASHBOARD=y

#
# Hardware Acceleration
#
BR2_PACKAGE_MESA3D=y
BR2_PACKAGE_MESA3D_GALLIUM_DRIVER_VC4=y
BR2_PACKAGE_MESA3D_GALLIUM_DRIVER_VIRGL=y
BR2_PACKAGE_MESA3D_OPENGL_EGL=y
BR2_PACKAGE_MESA3D_OPENGL_ES=y
BR2_PACKAGE_MESA3D_DRI_DRIVER=y
BR2_PACKAGE_LIBDRM=y
BR2_PACKAGE_LIBDRM_INSTALL_TESTS=y

#
# Wayland Display Server
#
BR2_PACKAGE_WAYLAND=y
BR2_PACKAGE_WAYLAND_PROTOCOLS=y
BR2_PACKAGE_WESTON=y
BR2_PACKAGE_WESTON_DEFAULT_COMPOSITOR="drm"
BR2_PACKAGE_WESTON_DRM=y
BR2_PACKAGE_WESTON_FBDEV=y
BR2_PACKAGE_WESTON_HEADLESS=y
BR2_PACKAGE_WESTON_SHELL_DESKTOP=y
BR2_PACKAGE_WESTON_SHELL_FULLSCREEN=y
BR2_PACKAGE_WESTON_SHELL_IVI=y
BR2_PACKAGE_WESTON_SHELL_KIOSK=y
BR2_PACKAGE_WESTON_DEMO_CLIENTS=y

#
# Qt5 Framework for AI Dashboard
#
BR2_PACKAGE_QT5=y
BR2_PACKAGE_QT5BASE=y
BR2_PACKAGE_QT5BASE_WIDGETS=y
BR2_PACKAGE_QT5BASE_GUI=y
BR2_PACKAGE_QT5BASE_NETWORK=y
BR2_PACKAGE_QT5BASE_CONCURRENT=y
BR2_PACKAGE_QT5BASE_SQL=y
BR2_PACKAGE_QT5BASE_SQLITE_QT=y
BR2_PACKAGE_QT5BASE_EGLFS=y
BR2_PACKAGE_QT5BASE_OPENGL=y
BR2_PACKAGE_QT5BASE_OPENGL_ES2=y
BR2_PACKAGE_QT5BASE_FONTCONFIG=y
BR2_PACKAGE_QT5BASE_HARFBUZZ=y
BR2_PACKAGE_QT5BASE_PNG=y
BR2_PACKAGE_QT5BASE_JPEG=y
BR2_PACKAGE_QT5CHARTS=y
BR2_PACKAGE_QT5DECLARATIVE=y
BR2_PACKAGE_QT5GRAPHICALEFFECTS=y
BR2_PACKAGE_QT5QUICKCONTROLS2=y
BR2_PACKAGE_QT5SVG=y
BR2_PACKAGE_QT5WAYLAND=y

#
# Fonts for GUI
#
BR2_PACKAGE_DEJAVU=y
BR2_PACKAGE_LIBERATION=y
BR2_PACKAGE_FONT_AWESOME=y

#
# Multimedia Support
#
BR2_PACKAGE_ALSA_UTILS=y
BR2_PACKAGE_FFMPEG=y
BR2_PACKAGE_FFMPEG_SWSCALE=y
BR2_PACKAGE_GSTREAMER1=y
BR2_PACKAGE_GST1_PLUGINS_BASE=y
BR2_PACKAGE_GST1_PLUGINS_GOOD=y
BR2_PACKAGE_V4L_UTILS=y

#
# Python (Optional, for development)
#
BR2_PACKAGE_PYTHON3=y
BR2_PACKAGE_PYTHON3_PY_PYC=y
BR2_PACKAGE_PYTHON_NUMPY=y
BR2_PACKAGE_PYTHON_PILLOW=y

#
# Container Support (Lightweight)
#
BR2_PACKAGE_PODMAN=n
BR2_PACKAGE_RUNC=y
BR2_PACKAGE_CONTAINERD=y

#
# Security
#
BR2_PACKAGE_OPENSSL=y
BR2_PACKAGE_CA_CERTIFICATES=y
BR2_PACKAGE_LIBSECCOMP=y

#
# Target Filesystem
#
BR2_TARGET_ROOTFS_SQUASHFS=y
BR2_TARGET_ROOTFS_SQUASHFS4_XZ=y
BR2_TARGET_ROOTFS_EXT2=y
BR2_TARGET_ROOTFS_EXT2_4=y
BR2_TARGET_ROOTFS_EXT2_SIZE="512M"
BR2_TARGET_ROOTFS_TAR=y
BR2_TARGET_ROOTFS_TAR_GZIP=y

#
# Bootloaders
#
BR2_TARGET_ROOTFS_CPIO=y
BR2_TARGET_ROOTFS_CPIO_GZIP=y

#
# Host Utilities
#
BR2_PACKAGE_HOST_CMAKE=y
BR2_PACKAGE_HOST_DOSFSTOOLS=y
BR2_PACKAGE_HOST_GENIMAGE=y
BR2_PACKAGE_HOST_MTOOLS=y
BR2_PACKAGE_HOST_PYTHON3=y
BR2_PACKAGE_HOST_PYTHON_NUMPY=y
BR2_PACKAGE_HOST_FLATBUFFERS=y
BR2_PACKAGE_HOST_PROTOBUF=y

#
# External Options
#
BR2_EXTERNAL_NEURAOS_PATH="$(TOPDIR)/../"
```

## configs/neuraos_minimal_defconfig
```kconfig
# NeuralOS Minimal Configuration (No GUI)
# Buildroot 2025.08.1 + Linux 6.12 LTS + PREEMPT_RT

#
# Target Architecture
#
BR2_aarch64=y
BR2_cortex_a53=y

#
# Build Options
#
BR2_OPTIMIZE_2=y
BR2_ENABLE_LTO=y
BR2_TOOLCHAIN_BUILDROOT_WCHAR=y
BR2_TOOLCHAIN_BUILDROOT_CXX=y

#
# System Configuration
#
BR2_TARGET_GENERIC_HOSTNAME="neuraos"
BR2_TARGET_GENERIC_ISSUE="Welcome to NeuralOS - AI-Native Embedded OS"
BR2_ROOTFS_DEVICE_CREATION_DYNAMIC_EUDEV=y
BR2_TARGET_GENERIC_ROOT_PASSWD="neuraos"
BR2_SYSTEM_DHCP="eth0"

#
# Kernel - Linux 6.12 LTS with native PREEMPT_RT
#
BR2_LINUX_KERNEL=y
BR2_LINUX_KERNEL_CUSTOM_VERSION=y
BR2_LINUX_KERNEL_CUSTOM_VERSION_VALUE="6.12.57"
BR2_LINUX_KERNEL_USE_CUSTOM_CONFIG=y
BR2_LINUX_KERNEL_CUSTOM_CONFIG_FILE="$(BR2_EXTERNAL_NEURAOS_PATH)/configs/kernel/neuraos_defconfig"
BR2_LINUX_KERNEL_NEEDS_HOST_OPENSSL=y

#
# Filesystem
#
BR2_TARGET_ROOTFS_EXT2=y
BR2_TARGET_ROOTFS_EXT2_4=y
BR2_TARGET_ROOTFS_EXT2_SIZE="512M"

#
# Bootloader - U-Boot 2025.01
#
BR2_TARGET_UBOOT=y
BR2_TARGET_UBOOT_BUILD_SYSTEM_KCONFIG=y
BR2_TARGET_UBOOT_CUSTOM_VERSION=y
BR2_TARGET_UBOOT_CUSTOM_VERSION_VALUE="2025.01"
BR2_TARGET_UBOOT_BOARD_DEFCONFIG="qemu_arm64"
BR2_TARGET_UBOOT_NEEDS_DTC=y
BR2_TARGET_UBOOT_FORMAT_BIN=y

#
# Essential Packages
#
BR2_PACKAGE_BUSYBOX=y
BR2_PACKAGE_BUSYBOX_SHOW_OTHERS=y

#
# Networking
#
BR2_PACKAGE_DROPBEAR=y
BR2_PACKAGE_IPTABLES=y
BR2_PACKAGE_IPROUTE2=y

#
# Development Tools
#
BR2_PACKAGE_GDB=y
BR2_PACKAGE_GDB_SERVER=y
BR2_PACKAGE_STRACE=y

#
# System Utilities
#
BR2_PACKAGE_HTOP=y
BR2_PACKAGE_PROCPS_NG=y

#
# Filesystem Tools
#
BR2_PACKAGE_E2FSPROGS=y
BR2_PACKAGE_DOSFSTOOLS=y

#
# Compression Tools
#
BR2_PACKAGE_BZIP2=y
BR2_PACKAGE_GZIP=y
BR2_PACKAGE_XZ=y
BR2_PACKAGE_ZLIB=y
BR2_PACKAGE_ZSTD=y

#
# Security & SSL/TLS
#
BR2_PACKAGE_OPENSSL=y
BR2_PACKAGE_CA_CERTIFICATES=y
BR2_PACKAGE_LIBSECCOMP=y

#
# Time Synchronization
#
BR2_PACKAGE_CHRONY=y

#
# Python Runtime (for AI tools)
#
BR2_PACKAGE_PYTHON3=y
BR2_PACKAGE_PYTHON3_PY_PYC=y
BR2_PACKAGE_PYTHON_NUMPY=y

#
# Libraries
#
BR2_PACKAGE_PROTOBUF=y
BR2_PACKAGE_FLATBUFFERS=y
BR2_PACKAGE_JSON_C=y

#
# AI/ML Frameworks
#
BR2_PACKAGE_EMLEARN=y

#
# NeuraParse Custom Packages
#
BR2_PACKAGE_NPIE=y
BR2_PACKAGE_NPI_INIT=y
BR2_PACKAGE_NEURAOS_TESTS=y
```

## configs/neuraos_x86_64_defconfig
```kconfig
# NeuralOS x86_64 Advanced Configuration
# Buildroot 2024.02.9 + Linux 6.12 LTS
# Enhanced with AI, Quantum, Drone, and Defense capabilities
# Updated: February 2026

#
# Target Architecture - x86_64
#
BR2_x86_64=y
BR2_x86_corei7=y

#
# Build Options
#
BR2_OPTIMIZE_2=y
BR2_TOOLCHAIN_BUILDROOT_WCHAR=y
BR2_TOOLCHAIN_BUILDROOT_CXX=y
BR2_TOOLCHAIN_BUILDROOT_LOCALE=y

#
# System Configuration
#
BR2_TARGET_GENERIC_HOSTNAME="neuraos"
BR2_TARGET_GENERIC_ISSUE="Welcome to NeuralOS x86_64 v2.0 - AI/Quantum/Robotics Platform"
BR2_ROOTFS_DEVICE_CREATION_DYNAMIC_EUDEV=y
BR2_TARGET_GENERIC_ROOT_PASSWD="neuraos"
BR2_SYSTEM_DHCP="eth0"

#
# Kernel - Linux 6.12 LTS
#
BR2_LINUX_KERNEL=y
BR2_LINUX_KERNEL_CUSTOM_VERSION=y
BR2_LINUX_KERNEL_CUSTOM_VERSION_VALUE="6.12.57"
BR2_LINUX_KERNEL_USE_CUSTOM_CONFIG=y
BR2_LINUX_KERNEL_CUSTOM_CONFIG_FILE="$(BR2_EXTERNAL_NEURAOS_PATH)/configs/kernel/neuraos_x86_64_defconfig"
BR2_LINUX_KERNEL_NEEDS_HOST_OPENSSL=y

#
# Filesystem
#
BR2_TARGET_ROOTFS_EXT2=y
BR2_TARGET_ROOTFS_EXT2_4=y
BR2_TARGET_ROOTFS_EXT2_SIZE="2G"

#
# Essential Packages
#
BR2_PACKAGE_BUSYBOX=y
BR2_PACKAGE_BUSYBOX_SHOW_OTHERS=y

#
# Networking
#
BR2_PACKAGE_DROPBEAR=y
BR2_PACKAGE_IPTABLES=y
BR2_PACKAGE_IPROUTE2=y
BR2_PACKAGE_TCPDUMP=y
BR2_PACKAGE_ETHTOOL=y
BR2_PACKAGE_LIBCURL=y
BR2_PACKAGE_LIBCURL_CURL=y

#
# Development Tools
#
BR2_PACKAGE_GDB=y
BR2_PACKAGE_GDB_SERVER=y

#
# System Utilities
#
BR2_PACKAGE_HTOP=y
BR2_PACKAGE_PROCPS_NG=y
BR2_PACKAGE_UTIL_LINUX=y
BR2_PACKAGE_UTIL_LINUX_BINARIES=y

#
# Filesystem Tools
#
BR2_PACKAGE_E2FSPROGS=y
BR2_PACKAGE_DOSFSTOOLS=y

#
# Compression Tools
#
BR2_PACKAGE_BZIP2=y
BR2_PACKAGE_GZIP=y
BR2_PACKAGE_XZ=y
BR2_PACKAGE_ZLIB=y
BR2_PACKAGE_ZSTD=y
BR2_PACKAGE_LZ4=y

#
# Security & SSL/TLS
#
BR2_PACKAGE_OPENSSL=y
BR2_PACKAGE_CA_CERTIFICATES=y
BR2_PACKAGE_LIBSECCOMP=y

#
# Time Synchronization
#
BR2_PACKAGE_CHRONY=y

#
# Python Runtime (for AI/Quantum tools)
#
BR2_PACKAGE_PYTHON3=y
BR2_PACKAGE_PYTHON3_PY_PYC=y
BR2_PACKAGE_PYTHON_NUMPY=y

#
# Libraries
#
BR2_PACKAGE_PROTOBUF=y
BR2_PACKAGE_FLATBUFFERS=y
BR2_PACKAGE_JSON_C=y
BR2_PACKAGE_JSONCPP=y
BR2_PACKAGE_BOOST=y
BR2_PACKAGE_BOOST_FILESYSTEM=y
BR2_PACKAGE_BOOST_SYSTEM=y
BR2_PACKAGE_ZEROMQ=y

#
# ========================================
# AI/ML Frameworks (NeuraParse Custom)
# ========================================
#

# Classical ML
BR2_PACKAGE_EMLEARN=y

# LLM Inference (llama.cpp for local AI)
BR2_PACKAGE_LLAMA_CPP=y

# Speech Recognition (whisper.cpp) - disabled due to FetchContent issues
# BR2_PACKAGE_WHISPER_CPP=y

# Text-to-Speech (Piper) - disabled due to FetchContent issues
# BR2_PACKAGE_PIPER_TTS=y

# Image Generation (Stable Diffusion) - disabled due to FetchContent issues
# BR2_PACKAGE_STABLE_DIFFUSION_CPP=y

# ONNX Runtime (disabled - complex CMake FetchContent dependencies)
# BR2_PACKAGE_ONNXRUNTIME=y

#
# ========================================
# Quantum Computing Tools
# ========================================
# (Most disabled due to CMake FetchContent/libcurl HTTPS issues)
#

# Qiskit Aer - Quantum Simulator (disabled - complex build deps)
# BR2_PACKAGE_QISKIT_AER=y

# PennyLane - Quantum ML (disabled - FetchContent issues)
# BR2_PACKAGE_PENNYLANE=y

# XACC - Quantum Programming Framework (disabled - complex deps)
# BR2_PACKAGE_XACC=y

# QuEST - Quantum Simulator (zero dependencies, embedded-friendly)
BR2_PACKAGE_QUEST=y

# Qulacs - Fast Quantum Circuit Simulator (disabled - complex deps)
# BR2_PACKAGE_QULACS=y

#
# ========================================
# Drone & Robotics Systems
# ========================================
# (Most disabled due to complex dependencies - can be added later)
#

# MAVLink Protocol (header-only, simple)
BR2_PACKAGE_MAVLINK=y

# MAVSDK - Modern Drone SDK (disabled - complex CMake dependencies)
# BR2_PACKAGE_MAVSDK=y

# PX4 Autopilot (disabled - needs kconfiglib)
# BR2_PACKAGE_PX4_AUTOPILOT=y

# ArduPilot (disabled - complex deps)
# BR2_PACKAGE_ARDUPILOT=y

# micro-ROS (disabled - complex deps)
# BR2_PACKAGE_ROS2_MICRO=y

# Fast-CDR (Fast-DDS dependency)
BR2_PACKAGE_FASTCDR=y

# Asio (Fast-DDS dependency)
BR2_PACKAGE_ASIO=y

# Foonathan Memory (Fast-DDS dependency)
BR2_PACKAGE_FOONATHAN_MEMORY=y

# Fast-DDS - Real-time pub/sub middleware
BR2_PACKAGE_FAST_DDS=y
BR2_PACKAGE_FAST_DDS_SECURITY=y
BR2_PACKAGE_FAST_DDS_SHM=y

# ORB-SLAM3 (disabled - requires OpenCV which is large)
# BR2_PACKAGE_ORB_SLAM3=y

#
# ========================================
# Defense & Security Tools
# ========================================
#

BR2_PACKAGE_DEFENSE_TOOLS=y

#
# ========================================
# Multimedia (for AI vision/audio)
# ========================================
#

BR2_PACKAGE_ALSA_UTILS=y
BR2_PACKAGE_FFMPEG=y
BR2_PACKAGE_FFMPEG_SWSCALE=y
BR2_PACKAGE_V4L_UTILS=y

#
# External Options
#
BR2_EXTERNAL_NEURAOS_PATH="$(TOPDIR)/../"
```
